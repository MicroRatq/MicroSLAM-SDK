## configs/uboot/arch/arm/mach-rockchip/rk3588/Kconfig
```kconfig
if ROCKCHIP_RK3588

config TARGET_EVB_RK3588
	bool "EVB_RK3588"
	select BOARD_LATE_INIT
	help
	  RK3588 EVB is a evaluation board for Rockchp RK3588.

config TARGET_MICROSLAM
	bool "MICROSLAM"
	select BOARD_LATE_INIT
	help
	  Support for MICROSLAM boards based on RK3588.

config SYS_SOC
	default "rockchip"

config SYS_MALLOC_F_LEN
	default 0x400

source board/rockchip/evb_rk3588/Kconfig
source board/rockchip/microslam/Kconfig

endif
```

## configs/uboot/board/rockchip/microslam/Kconfig
```kconfig
if TARGET_MICROSLAM

config SYS_BOARD
	default "microslam"

config SYS_VENDOR
	default "rockchip"

config SYS_CONFIG_NAME
	default "microslam"

config BOARD_SPECIFIC_OPTIONS # dummy
	def_bool y

endif
```
